## config/boards/shields/left_bbtrackpad_keypoint/dts/bindings/zmk,input-processor-pointer-boost.yaml
```yaml
# Pointer boost input processor.
#
# While a key position in boost-positions is held and the layer in
# active-layer is active, wheel input is multiplied by boost-factor and
# cursor movement is divided down to a slow, capped rate.
#
# SPDX-License-Identifier: MIT

description: >
  Input Processor boosting scroll speed and slowing cursor movement to a
  precise rate while configured key positions are held.

compatible: "zmk,input-processor-pointer-boost"

include: ip_zero_param.yaml

properties:
  boost-factor:
    type: int
    required: true
    description: Multiplier applied to wheel input while a boost key is held

  move-divisor:
    type: int
    required: false
    default: 1
    description: >
      Divisor applied to relative cursor movement while a boost key is
      held, with a fractional remainder carried across events.
      1 disables the precision mode.

  move-max-step:
    type: int
    required: false
    default: 0
    description: >
      Maximum movement in pixels reported per event while a boost key is
      held; excess is dropped so hard pushes move at a fixed slow rate.
      0 disables the cap.

  clutch-idle-ms:
    type: int
    required: false
    default: 200
    description: >
      After the last precision key is released during movement, the
      pointer is frozen until movement has been idle for this long;
      pushing again afterwards resumes movement.

  boost-positions:
    type: array
    required: false
    default: []
    description: Key positions that enable the scroll speed boost while held

  precision-positions:
    type: array
    required: false
    default: []
    description: >
      Key positions that enable the cursor precision mode while held,
      independent of the wheel boost trigger list.

  active-layer:
    type: int
    required: false
    default: -1
    description: >
      Only apply the boost while this layer index is active.
      -1 removes the gate (boost on any layer).
```

## config/boards/shields/left_bbtrackpad_keypoint/dts/bindings/zmk,input-processor-temp-layer-ext.yaml
```yaml
# Extended temporary layer input processor, based on ZMK's
# zmk,input-processor-temp-layer (v0.3.0).
#
# SPDX-License-Identifier: MIT

description: >
  Input Processor for temporarily enabling a layer after input events.

  Extended with an arm-only mode: such an instance never activates the layer
  itself, but while the layer is already active each event pushes the layer
  exit deadline out again. Used so keyboard mouse buttons (&mkp LCLK/RCLK
  etc.) refresh the mouse layer exit timer without ever turning the layer on.

compatible: "zmk,input-processor-temp-layer-ext"

include: ip_two_param.yaml

properties:
  require-prior-idle-ms:
    type: int
    required: false
    default: 0
    description: Time in milliseconds that must pass after the last keystroke before the layer can be toggled

  excluded-positions:
    type: array
    required: false
    default: []
    description: Array of key positions that will NOT trigger layer deactivation when pressed

  arm-only:
    type: boolean
    required: false
    description: >
      Never activate the layer from these input events; only refresh the
      layer exit timeout while the layer is already active.
```

## config/boards/shields/lpm_view/dts/bindings/zmk,behavior-mfl.yaml
```yaml
# "Exit layer -> momentary layer" behavior.
#
# SPDX-License-Identifier: MIT

description: |
  Deactivate one layer and momentarily hold another on press.

  Usage: &mfl <exit_layer> <hold_layer>

  Press deactivates exit_layer (e.g. the pointing-device temp mouse layer,
  also cancelling its exit timer) and activates hold_layer; release
  deactivates hold_layer.

compatible: "zmk,behavior-mfl"

include: two_param.yaml
```

## config/boards/shields/right_trackpoint_keypoint/Kconfig.shield
```kconfig
# Copyright (c) 2022 The ZMK Contributors
# SPDX-License-Identifier: MIT

config SHIELD_RIGHT_TRACKPOINT_KEYPOINT
    def_bool $(shields_list_contains,right_trackpoint_keypoint)


menu "TrackPoint Advanced Settings"

config TRACKPOINT_POINTER_ACCEL
    bool "Enable velocity-based pointer acceleration"
    default y
    help
      Lenovo-style acceleration: output gain follows how hard/fast the
      TrackPoint is pushed. Light touch = slow precise movement, firm
      push = fast travel. The gain curve is min..max, reaching max at the
      configured input speed.

config TRACKPOINT_ACCEL_MIN_PERCENT
    int "Pointer acceleration minimum gain (Percentage, 60 = 0.6x)"
    default 62
    help
      Gain applied to the slowest movements (precise end of the curve).
      Calibrated 2026-09-30 from native ThinkPad trace: host ballistics
      give ~0.31 px/count at light touch.

config TRACKPOINT_ACCEL_MAX_PERCENT
    int "Pointer acceleration maximum gain (Percentage, 260 = 2.6x)"
    default 230
    help
      Gain applied at and above the configured maximum input speed.
      Calibrated 2026-09-30 from native trace (170), raised to 230 after
      user testing: firm pushes need more top-end speed on this host.

config TRACKPOINT_ACCEL_VMAX_X10
    int "Input speed where max gain is reached (counts/ms, times 10)"
    default 45
    help
      TrackPoint input speed (counts per millisecond, x10) at which the
      acceleration curve saturates. Calibrated 2026-09-30: 45 = 4.5 c/ms.

config TRACKPOINT_ACCEL_POW_X10
    int "Acceleration curve steepness (exponent, times 10)"
    default 9
    help
      Shape of the curve between min and max gain. Calibrated
      2026-09-30 from native trace fit (nearly linear).

config TRACKPOINT_SCROLL_X_DIR
    int "Scroll X direction multiplier (1 for normal, -1 for inverted)"
    default 1

config TRACKPOINT_SCROLL_Y_DIR
    int "Scroll Y direction multiplier (1 for normal, -1 for inverted)"
    default 1

config TRACKPOINT_SCROLL_DEADZONE
    int "Scroll deadzone"
    default 2
    help
      Deadzone to filter out slight hand tremors.

config TRACKPOINT_SCROLL_INPUT_MAX
    int "Scroll input max"
    default 128

config TRACKPOINT_SCROLL_DIVISOR_SLOW
    int "Scroll divisor slow (Fine-grained control)"
    default 60

config TRACKPOINT_SCROLL_DIVISOR_FAST
    int "Scroll divisor fast (Max speed limit)"
    default 8

config TRACKPOINT_DOMINANT_NUMERATOR
    int "Dominant axis numerator for accidental touch prevention"
    default 3

config TRACKPOINT_DOMINANT_DENOMINATOR
    int "Dominant axis denominator for accidental touch prevention"
    default 2

config TRACKPOINT_MOUSE_BASE_SPEED_PERCENT
    int "Mouse base speed (Percentage, 50 = 0.5)"
    default 50

endmenu
```
